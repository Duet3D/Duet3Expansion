# ATSAM4SP32A device description
Architecture: CORTEX-M4; Family: SAM4; Series: SAM4SP
Parameters: __CM4_REV=0x0001, __MPU_PRESENT=1, __FPU_PRESENT=0, __NVIC_PRIO_BITS=4, __Vendor_SysTickConfig=0
Programming and debug interfaces: JTAG, SWD
Registers are 32-bit, read-write, no defined reset value unless marked. A register's access mark holds for its fields unless they carry their own. Offsets are from the block's base; lines under a group give offsets from that group; [hi:lo] are bit positions; {n}, {i} and the like mark numbered series; 'fields as' and 'values as' point back to an identical list; <NAME> marks a mode.

## Ordering variants
ATSAM4SP32A-AU: LQFP128, up to 120 MHz, -40 to +85 C, 3.0 to 3.6 V

## Memory
base space: start 0 size 0x100000000, little endian
  0x40000000 PERIPHERALS size 0x20000000 io
  0xE0000000 SYSTEM size 0x10000000 io
  0x00400000 IFLASH0 size 0x00100000 flash, page 512
  0x00500000 IFLASH1 size 0x00100000 flash, page 512
  0x00800000 IROM size 0x00400000 rom
  0x20000000 IRAM size 0x00028000 ram
fuses space: start 0 size 1, little endian
lockbits space: start 0 size 0x20, little endian

## Peripheral instances (address, pins/pin function, parameters)
ACC at 0x40040000
ADC at 0x40038000
  pins: ADTRG PA8/B; AD0 PA17/X1; AD1 PA18/X1; AD2 PA19/X1; WKUP9 PA19/X1; AD3 PA20/X1; WKUP10 PA20/X1; AD4 PB0/X1; RTCOUT0 PB0/X1; AD5 PB1/X1; RTCOUT1 PB1/X1; AD6 PB2/X1; WKUP12 PB2/X1; AD7 PB3/X1; AD8 PA21/X1; AD9 PA22/X1
CHIPID at 0x400E0740
CMCC at 0x4007C000
CRCCU at 0x40044000
DACC at 0x4003C000
  pins: DAC0 PB13/X1; DATRG PA2/C
EFC0 at 0x400E0A00 (EFC)
  parameters: FLASH_SIZE=1048576, PAGE_SIZE=512, PAGES_PR_REGION=16
EFC1 at 0x400E0C00 (EFC)
  parameters: FLASH_SIZE=1048576, PAGE_SIZE=512, PAGES_PR_REGION=16
GPBR at 0x400E1490
MATRIX at 0x400E0200
PIOA at 0x400E0E00 (PIO)
  pins: PIODCCLK PA23/D; PIODCEN1 PA15/D; PIODCEN2 PA16/D; PIODC0 PA24/D; PIODC1 PA25/D
PIOB at 0x400E1000 (PIO)
PIOC at 0x400E1200 (PIO)
PMC at 0x400E0400
  pins: PCK0 PA6/B or PB13/B; PCK1 PA17/B or PA21/B; PCK2 PA18/B or PB3/B
PPLC at 0x40008000
  pins: PMISO PA12/A; PMOSI PA13/A; PNPCS0 PA11/A; PSPCK PA14/A
PWM at 0x40020000
  pins: PWMFI0 PA9/C; PWMH0 PA0/A or PA23/B or PB0/A; PWMH1 PA1/A or PA24/B or PB1/A; PWMH2 PA2/A or PA25/B or PB4/B; PWMH3 PA7/B or PA17/C; PWML0 PA19/B or PB5/B or PC0/B; PWML1 PA20/B or PB12/A; PWML2 PA16/C or PB13/A; PWML3 PA15/C
RSTC at 0x400E1400
RTC at 0x400E1460
RTT at 0x400E1430
SSC at 0x40004000
  pins: RD PA18/A; RF PA20/A; RK PA19/A; TD PA17/A; TF PA15/A; TK PA16/A
SUPC at 0x400E1410
TC0 at 0x40010000 (TC)
  pins: TCLK0 PA4/B; TIOA0 PA0/B; TIOA1 PA15/B; TIOB0 PA1/B; TIOB1 PA16/B
TC1 at 0x40014000 (TC)
TWI0 at 0x40018000 (TWI)
  pins: TWCK0 PA4/A; TWD0 PA3/A
TWI1 at 0x4001C000 (TWI)
  pins: TWCK1 PB5/A; TWD1 PB4/A
UART0 at 0x400E0600 (UART)
  pins: URXD0 PA9/A; UTXD0 PA10/A
UART1 at 0x400E0800 (UART)
  pins: URXD1 PB2/A; UTXD1 PB3/A
UDP at 0x40034000
USART0 at 0x40024000 (USART)
  pins: CTS0 PA8/A; RTS0 PA7/A; RXD0 PA5/A; SCK0 PA2/B; TXD0 PA6/A
USART1 at 0x40028000 (USART)
  pins: CTS1 PA25/A; RTS1 PA24/A; RXD1 PA21/A; SCK1 PA23/A; TXD1 PA22/A
WDT at 0x400E1450
FUSES at GPNVMBITS 0 in fuses
LOCKBIT at 0 in lockbits
SystemControl at 0xE000E000
SysTick at 0xE000E010
NVIC at 0xE000E100
MPU at 0xE000ED90

## Interrupts
-14 NonMaskableInt_IRQn — Non Maskable Interrupt
-12 MemoryManagement_IRQn — Cortex-M4 Memory Management Interrupt
-11 BusFault_IRQn — Cortex-M4 Bus Fault Interrupt
-10 UsageFault_IRQn — Cortex-M4 Usage Fault Interrupt
-5 SVCall_IRQn — Cortex-M4 SV Call Interrupt
-4 DebugMonitor_IRQn — Cortex-M4 Debug Monitor Interrupt
-2 PendSV_IRQn — Cortex-M4 Pend SV Interrupt
-1 SysTick_IRQn — Cortex-M4 System Tick Interrupt
0 SUPC (SYSC) — Supply Controller
1 RSTC (SYSC) — Reset Controller
2 RTC (SYSC) — Real Time Clock
3 RTT (SYSC) — Real Time Timer
4 WDT (SYSC) — Watchdog Timer
5 PMC — Power Management Controller
6 EFC0 — Enhanced Embedded Flash Controller 0
7 EFC1 — Enhanced Embedded Flash Controller 1
8 UART0
9 UART1
11 PIOA — Parallel I/O Controller A
12 PIOB — Parallel I/O Controller B
13 PIOC — Parallel I/O Controller C
14 USART0
15 USART1
19 TWI0 — Two Wire Interface 0
20 TWI1 — Two Wire Interface 1
21 PPLC — Proxy Power Line Communication
22 SSC — Synchronous Serial Controller
23 TC0 — Timer/Counter 0
24 TC1 (TC0) — Timer/Counter 1
25 TC2 (TC0) — Timer/Counter 2
26 TC3 (TC1) — Timer/Counter 3
27 TC4 (TC1) — Timer/Counter 4
28 TC5 (TC1) — Timer/Counter 5
29 ADC — Analog To Digital Converter
30 DACC — Digital To Analog Converter
31 PWM — Pulse Width Modulation
32 CRCCU — CRC Calculation Unit
33 ACC — Analog Comparator
34 UDP — USB Device Port

## Properties
SIGNATURES: JTAGID=0x05B3203F, CHIPID_CIDR=0x29A70EE8

## Notices in the file
SAM Software Package License
Copyright (c) %copyright_year%, Atmel Corporation
All rights reserved.
Redistribution and use in source and binary forms, with or without
modification, are permitted provided that the following condition is met:
- Redistributions of source code must retain the above copyright notice,
this list of conditions and the disclaimer below.
Atmel's name may not be used to endorse or promote products derived from
this software without specific prior written permission.
DISCLAIMER:  THIS SOFTWARE IS PROVIDED BY ATMEL "AS IS" AND ANY EXPRESS OR
IMPLIED WARRANTIES, INCLUDING, BUT NOT LIMITED TO, THE IMPLIED WARRANTIES OF
MERCHANTABILITY, FITNESS FOR A PARTICULAR PURPOSE AND NON-INFRINGEMENT ARE
DISCLAIMED. IN NO EVENT SHALL ATMEL BE LIABLE FOR ANY DIRECT, INDIRECT,
INCIDENTAL, SPECIAL, EXEMPLARY, OR CONSEQUENTIAL DAMAGES (INCLUDING, BUT NOT
LIMITED TO, PROCUREMENT OF SUBSTITUTE GOODS OR SERVICES; LOSS OF USE, DATA,
OR PROFITS; OR BUSINESS INTERRUPTION) HOWEVER CAUSED AND ON ANY THEORY OF
LIABILITY, WHETHER IN CONTRACT, STRICT LIABILITY, OR TORT (INCLUDING
NEGLIGENCE OR OTHERWISE) ARISING IN ANY WAY OUT OF THE USE OF THIS SOFTWARE,
EVEN IF ADVISED OF THE POSSIBILITY OF SUCH DAMAGE.
