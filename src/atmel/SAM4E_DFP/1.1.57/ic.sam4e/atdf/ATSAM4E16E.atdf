# ATSAM4E16E device description
Architecture: CORTEX-M4; Family: SAM4; Series: SAM4E
Parameters: __CM4_REV=0x0000, __MPU_PRESENT=1, __FPU_PRESENT=1, __NVIC_PRIO_BITS=4, __Vendor_SysTickConfig=0
Programming and debug interfaces: JTAG, SWD
Registers are 32-bit, read-write, no defined reset value unless marked. A register's access mark holds for its fields unless they carry their own. Offsets are from the block's base; lines under a group give offsets from that group; [hi:lo] are bit positions; {n}, {i} and the like mark numbered series; 'fields as' and 'values as' point back to an identical list; <NAME> marks a mode.

## Ordering variants
ATSAM4E16E-CU: LFBGA144, up to 120 MHz, -40 to +85 C, 1.62 to 3.60 V
ATSAM4E16E-AU: LQFP144, up to 120 MHz, -40 to +85 C, 1.62 to 3.60 V

## Memory
base space: start 0 size 0x100000000, little endian
  0x40000000 PERIPHERALS size 0x20000000 io
  0xE0000000 SYSTEM size 0x10000000 io
  0x00400000 IFLASH size 0x00100000 flash, page 512
  0x00800000 IROM size 0x00400000 rom
  0x20000000 IRAM size 0x00020000 ram
  0x60000000 EBI_CS0 size 0x01000000 other
  0x61000000 EBI_CS1 size 0x01000000 other
  0x62000000 EBI_CS2 size 0x01000000 other
  0x63000000 EBI_CS3 size 0x01000000 other
fuses space: start 0 size 1, little endian
lockbits space: start 0 size 0x10, little endian

## Peripheral instances (address, pins/pin function, parameters)
ACC at 0x400BC000
AES at 0x40004000
AFEC0 at 0x400B0000 (AFEC)
  pins: AFE0_ADTRG PA8/B; AFE0_AD0 PA17/X1; AFE0_AD1 PA18/X1; AFE0_AD2 PA19/X1; WKUP9 PA19/X1; AFE0_AD3 PA20/X1; WKUP10 PA20/X1; AFE0_AD4 PB0/X1; RTCOUT0 PB0/X1; AFE0_AD5 PB1/X1; RTCOUT1 PB1/X1; AFE0_AD6 PC13/X1; AFE0_AD7 PC15/X1; AFE0_AD8 PC12/X1; AFE0_AD9 PC29/X1; AFE0_AD10 PC30/X1; AFE0_AD11 PC31/X1; AFE0_AD12 PC26/X1; AFE0_AD13 PC27/X1; AFE0_AD14 PC0/X1
AFEC1 at 0x400B4000 (AFEC)
  pins: AFE1_AD0 PB2/X1; WKUP12 PB2/X1; AFE1_AD1 PB3/X1; AFE1_AD2 PA21/X1; AFE1_AD3 PA22/X1; AFE1_AD4 PC1/X1; AFE1_AD5 PC2/X1; AFE1_AD6 PC3/X1; AFE1_AD7 PC4/X1
CAN0 at 0x40010000 (CAN)
  pins: CANRX0 PB3/A; CANTX0 PB2/A
CAN1 at 0x40014000 (CAN)
  pins: CANRX1 PC12/C; CANTX1 PC15/C
CHIPID at 0x400E0740
CMCC at 0x400C4000
CRCCU at 0x40044000
DACC at 0x400B8000
  pins: DAC0 PB13/X1; DAC1 PB14/X1; DATRG PA2/C
DMAC at 0x400C0000
EFC at 0x400E0A00
  parameters: FLASH_SIZE=1048576, PAGE_SIZE=512, PAGES_PR_REGION=16
GMAC at 0x40034000
  pins: GCOL PD13/A; GCRS PD10/A; GCRSDV PD4/A; GRXDV PD4/A; GMDC PD8/A; GMDIO PD9/A; GRXCK PD14/A; GRXER PD7/A; GRX0 PD5/A or PD6/A; GRX2 PD11/A; GRX3 PD12/A; GTXCK PD0/A; GREFCK PD0/A; GTXEN PD1/A; GTXER PD17/A; GTX0 PD2/A; GTX1 PD3/A; GTX2 PD15/A; GTX3 PD16/A
GPBR at 0x400E1890
HSMCI at 0x40080000
  pins: MCCDA PA28/C; MCCK PA29/C; MCDA0 PA30/C; MCDA1 PA31/C; MCDA2 PA26/C; MCDA3 PA27/C
MATRIX at 0x400E0200
PIOA at 0x400E0E00 (PIO)
  pins: P{n} PA{n} (n=0..31); PIODCCLK PA23/X1; PIODC{n} PA{n+24}/X1 (n=0..7); WKUP11 PA30/X1; WKUP14 PA15/X1; PIODCEN1 PA15/X1; WKUP15 PA16/X1; PIODCEN2 PA16/X1
PIOB at 0x400E1000 (PIO)
  pins: P{n} PB{n-32} (n=32..46)
PIOC at 0x400E1200 (PIO)
  pins: P{n} PC{n-64} (n=64..95)
PIOD at 0x400E1400 (PIO)
  pins: P{n} PD{n-96} (n=96..127)
PIOE at 0x400E1600 (PIO)
  pins: P128 PE0; P129 PE1; P130 PE2; P131 PE3; P132 PE4; P133 PE5
PMC at 0x400E0400
  pins: PCK0 PA6/B or PB13/B; PCK1 PA17/B or PA21/B; PCK2 PA18/B or PA31/B or PB3/B
PWM at 0x40000000
  pins: PWMFI0 PA9/C; PWMH0 PA0/A or PA11/B or PA23/B or PB0/A or PC18/B or PD20/A; PWMH1 PA1/A or PA12/B or PA24/B or PB1/A or PC19/B or PD21/A; PWMH2 PA2/A or PA13/B or PA25/B or PB4/B or PC20/B or PD22/A; PWMH3 PA7/B or PA14/B or PA17/C or PB14/B or PC21/B or PD23/A; PWML0 PA19/B or PB5/B or PC0/B or PC13/B or PD24/A; PWML1 PA20/B or PB12/A or PC1/B or PC15/B or PD25/A; PWML2 PA16/C or PA30/A or PB13/A or PC2/B or PD26/A; PWML3 PA15/C or PC3/B or PC22/B or PD27/A
RSTC at 0x400E1800
RTC at 0x400E1860
RTT at 0x400E1830
SMC at 0x40060000
SPI at 0x40088000
  pins: MISO PA12/A; MOSI PA13/A; NPCS0 PA11/A; NPCS1 PA9/B or PA31/A or PB14/A or PC4/B; NPCS2 PA10/B or PA30/B or PB2/B; NPCS3 PA3/B or PA5/B or PA22/B; SPCK PA14/A
SUPC at 0x400E1810
TC0 at 0x40090000 (TC)
  pins: TCLK0 PA4/B; TCLK1 PA28/B; TCLK2 PA29/B; TIOA0 PA0/B; TIOA1 PA15/B; TIOA2 PA26/B; TIOB0 PA1/B; TIOB1 PA16/B; TIOB2 PA27/B
TC1 at 0x40094000 (TC)
  pins: TCLK3 PC25/B; TCLK4 PC28/B; TCLK5 PC31/B; TIOA3 PC23/B; TIOA4 PC26/B; TIOA5 PC29/B; TIOB3 PC24/B; TIOB4 PC27/B; TIOB5 PC30/B
TC2 at 0x40098000 (TC)
  pins: TCLK6 PC7/B; TCLK7 PC10/B; TCLK8 PC14/B; TIOA6 PC5/B; TIOA7 PC8/B; TIOA8 PC11/B; TIOB6 PC6/B; TIOB7 PC9/B; TIOB8 PC12/B
TWI0 at 0x400A8000 (TWI)
  pins: TWCK0 PA4/A; TWD0 PA3/A
TWI1 at 0x400AC000 (TWI)
  pins: TWCK1 PB5/A; TWD1 PB4/A
UART0 at 0x400E0600 (UART)
  pins: URXD0 PA9/A; UTXD0 PA10/A
UART1 at 0x40060600 (UART)
  pins: URXD1 PA5/C; UTXD1 PA6/C
UDP at 0x40084000
USART0 at 0x400A0000 (USART)
  pins: CTS0 PB2/C; RTS0 PB3/C; RXD0 PB0/C; SCK0 PB13/C; TXD0 PB1/C
USART1 at 0x400A4000 (USART)
  pins: CTS1 PA25/A; DCD1 PA26/A; DSR1 PA28/A; DTR1 PA27/A; RI1 PA29/A; RTS1 PA24/A; RXD1 PA21/A; SCK1 PA23/A; TXD1 PA22/A
WDT at 0x400E1850
FUSES at GPNVMBITS 0 in fuses
LOCKBIT at 0 in lockbits
SystemControl at 0xE000E000
SysTick at 0xE000E010
NVIC at 0xE000E100
MPU at 0xE000ED90

## Interrupts
0 SUPC_IRQn (SUPC) — Supply Controller
1 RSTC_IRQn (RSTC) — Reset Controller
2 RTC_IRQn (RTC) — Real Time Clock
3 RTT_IRQn (RTT) — Real Time Timer
4 WDT_IRQn (WDT) — Watchdog/Dual Watchdog Timer
5 PMC_IRQn (PMC) — Power Management Controller
6 EFC_IRQn (EFC) — Enhanced Embedded Flash Controller
7 UART0_IRQn (UART0) — UART 0
9 PIOA_IRQn (PIOA) — Parallel I/O Controller A
10 PIOB_IRQn (PIOB) — Parallel I/O Controller B
11 PIOC_IRQn (PIOC) — Parallel I/O Controller C
12 PIOD_IRQn (PIOD) — Parallel I/O Controller D
13 PIOE_IRQn (PIOE) — Parallel I/O Controller E
14 USART0_IRQn (USART0) — USART 0
15 USART1_IRQn (USART1) — USART 1
16 HSMCI_IRQn (HSMCI) — Multimedia Card Interface
17 TWI0_IRQn (TWI0) — Two Wire Interface 0
18 TWI1_IRQn (TWI1) — Two Wire Interface 1
19 SPI_IRQn (SPI) — Serial Peripheral Interface
20 DMAC_IRQn (DMAC) — DMAC
21 TC0_IRQn (TC0) — Timer/Counter 0
22 TC1_IRQn (TC0) — Timer/Counter 1
23 TC2_IRQn (TC0) — Timer/Counter 2
24 TC3_IRQn (TC1) — Timer/Counter 3
25 TC4_IRQn (TC1) — Timer/Counter 4
26 TC5_IRQn (TC1) — Timer/Counter 5
27 TC6_IRQn (TC2) — Timer/Counter 6
28 TC7_IRQn (TC2) — Timer/Counter 7
29 TC8_IRQn (TC2) — Timer/Counter 8
30 AFEC0_IRQn (AFEC0) — Analog Front End 0
31 AFEC1_IRQn (AFEC1) — Analog Front End 1
32 DACC_IRQn (DACC) — Digital To Analog Converter
33 ACC_IRQn (ACC) — Analog Comparator
35 UDP_IRQn (UDP) — USB DEVICE
36 PWM_IRQn (PWM) — PWM
37 CAN0_IRQn (CAN0) — CAN0
38 CAN1_IRQn (CAN1) — CAN1
39 AES_IRQn (AES) — AES
44 GMAC_IRQn (GMAC) — EMAC
45 UART1_IRQn (UART1) — UART

## Properties
SIGNATURES: JTAGID=0x05B3703F, CHIPID_CIDR=0xA3CC0CE0, CHIPID_EXID=0x00120200

## Notices in the file
SAM Software Package License
Copyright (c) %copyright_year%, Atmel Corporation
All rights reserved.
Redistribution and use in source and binary forms, with or without
modification, are permitted provided that the following condition is met:
- Redistributions of source code must retain the above copyright notice,
this list of conditions and the disclaimer below.
Atmel's name may not be used to endorse or promote products derived from
this software without specific prior written permission.
DISCLAIMER:  THIS SOFTWARE IS PROVIDED BY ATMEL "AS IS" AND ANY EXPRESS OR
IMPLIED WARRANTIES, INCLUDING, BUT NOT LIMITED TO, THE IMPLIED WARRANTIES OF
MERCHANTABILITY, FITNESS FOR A PARTICULAR PURPOSE AND NON-INFRINGEMENT ARE
DISCLAIMED. IN NO EVENT SHALL ATMEL BE LIABLE FOR ANY DIRECT, INDIRECT,
INCIDENTAL, SPECIAL, EXEMPLARY, OR CONSEQUENTIAL DAMAGES (INCLUDING, BUT NOT
LIMITED TO, PROCUREMENT OF SUBSTITUTE GOODS OR SERVICES; LOSS OF USE, DATA,
OR PROFITS; OR BUSINESS INTERRUPTION) HOWEVER CAUSED AND ON ANY THEORY OF
LIABILITY, WHETHER IN CONTRACT, STRICT LIABILITY, OR TORT (INCLUDING
NEGLIGENCE OR OTHERWISE) ARISING IN ANY WAY OUT OF THE USE OF THIS SOFTWARE,
EVEN IF ADVISED OF THE POSSIBILITY OF SUCH DAMAGE.
